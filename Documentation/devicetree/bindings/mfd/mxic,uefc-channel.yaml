## Documentation/devicetree/bindings/mfd/mxic,uefc-channel.yaml
```yaml
# SPDX-License-Identifier: (GPL-2.0-only OR BSD-2-Clause)
%YAML 1.2
---
$id: http://devicetree.org/schemas/mfd/mxic,uefc-channel.yaml#
$schema: http://devicetree.org/meta-schemas/core.yaml#

title: Macronix UEFC Channel

maintainers:
  - Toto <toto@gmail.com>

description: |
  UEFC's channel description.

properties:
  "#address-cells":
    const: 1
  "#size-cells":
    const: 0

  reg:
    description: channel ID
    enum: [0, 1]

  clocks:
    minItems: 2
    maxItems: 2

  clock-names:
    items:
      - const: rx
      - const: tx

  mxic,parrallel-mode:
    description: The device is connected to both channels (A & B)
    type: boolean

patternProperties:
  "^.*@[0-9a-fA-F]+$":
    type: object
    description: Memory device nodes

    properties:
      memory-region:
        description:
          Memory region to be used for memory-map read access.

required:
  - '#address-cells'
  - '#size-cells'
  - reg
  - clocks
  - clock-names

additionalProperties: true
```

## Documentation/devicetree/bindings/mfd/mxic,uefc.yaml
```yaml
# SPDX-License-Identifier: GPL-2.0-only OR BSD-2-Clause
%YAML 1.2
---
$id: http://devicetree.org/schemas/mfd/mxic,uefc.yaml#
$schema: http://devicetree.org/meta-schemas/core.yaml#

title: Macronix UEFC (Unified Extensible Flash Controller)

maintainers:
  - Cheng Ming Lin <chengminglin@mxic.com.tw>

description: |
  The Macronix Unified Extensible Flash Controller (UEFC) is a multi-protocol
  flash host controller. It is exposed as an MFD whose child devices implement
  the per-channel protocols (xSPI, raw NAND or eMMC), all sharing the host
  controller register block and a pair of channels (A and B).

properties:
  compatible:
    enum:
      - mxic,uefc

  reg:
    minItems: 1
    items:
      - description: Host controller register block
      - description:
          Direct-mapped window the flash contents are accessed through,
          bypassing the register interface.

  reg-names:
    minItems: 1
    items:
      - const: regs
      - const: dirmap

  interrupts:
    maxItems: 2

  interrupt-names:
    items:
      - const: error
      - const: status

  reset-gpios:
    maxItems: 1
    description: GPIO connected the active-low reset

  clocks:
    items:
      - description: Clock domain 1, the system side of the TX/RX FIFO.
      - description:
          Clock domain 2, the device side of the TX/RX FIFO. The serial clock
          driven to the memory devices is derived from this one.
      - description:
          Output logic of the channel A interface. Must be synchronous with
          the device side clock and an integer multiple of its rate.
      - description:
          Input logic of the channel A interface. Must be synchronous with the
          device side clock and an integer multiple of its rate.
      - description: Output logic of the channel B interface, as for channel A.
      - description: Input logic of the channel B interface, as for channel A.

  clock-names:
    items:
      - const: sys
      - const: ss
      - const: tx_a
      - const: rx_a
      - const: tx_b
      - const: rx_b

  "#address-cells":
    enum: [0, 1]

  "#size-cells":
    const: 0

patternProperties:
  "^nand-controller":
    type: object
    $ref: /schemas/mtd/mxic,uefc-nand.yaml#

  "^mmc":
    type: object
    $ref: /schemas/mmc/mxic,uefc-mmc.yaml#

  "^spi":
    type: object
    $ref: /schemas/spi/mxic,uefc-xspi.yaml#

required:
  - compatible
  - reg
  - reg-names
  - clocks
  - clock-names
  - "#address-cells"
  - "#size-cells"

additionalProperties: false

examples:
  - |

    amba {
      #address-cells = <1>;
      #size-cells = <1>;

      uefc: uefc@43a00000 {
        compatible = "mxic,uefc";
        reg = <0x43a00000 0x1000>, <0x60000000 0x4000000>;
        reg-names = "regs", "dirmap";
        clocks = <&clk_sys>, <&clk_ss>,
                 <&clk_if>, <&clk_if>, <&clk_if>, <&clk_if>;
        clock-names = "sys", "ss", "tx_a", "rx_a", "tx_b", "rx_b";
        #address-cells = <1>;
        #size-cells = <0>;

        nand-controller@0 {
          compatible = "mxic,uefc-nand";
          #address-cells = <1>;
          #size-cells = <0>;
          reg = <0>;
        };

        spi@1 {
          compatible = "mxic,uefc-xspi";
          #address-cells = <1>;
          #size-cells = <0>;
          reg = <1>;
        };
      };
    };
...
```

## Documentation/devicetree/bindings/mmc/mxic,uefc-mmc.yaml
```yaml
# SPDX-License-Identifier: (GPL-2.0-only OR BSD-2-Clause)
%YAML 1.2
---
$id: http://devicetree.org/schemas/mmc/mxic,uefc-mmc.yaml#
$schema: http://devicetree.org/meta-schemas/core.yaml#

title: Macronix UEFC eMMC Controller

maintainers:
  - Todo <todo@gmail.com>

allOf:
  - $ref: mmc-controller.yaml

properties:
  compatible:
    enum:
      - mxic,uefc-mmc

  dmas:
    description: DMA channel for DMA slave mode

  reg:
    description: UEFC channel used
    enum: [0, 1]

  vcc-gpios:
    description: Optional GPIO controlling the card power (VCC) supply
    maxItems: 1

  vccq-gpios:
    description: Optional GPIO controlling the card I/O (VCCQ) supply
    maxItems: 1

required:
  - compatible
  - reg

unevaluatedProperties: false

examples:
  - |

    amba {
      #address-cells = <1>;
      #size-cells = <1>;

      uefc: uefc@43a00000 {
        compatible = "mxic,uefc";
        reg = <0x43a00000 0x1000>;
        clocks = <&clk_sys>, <&clk_ss>, <&clk_ss>, <&clk_ss>, <&clk_ss>, <&clk_ss>;
        clock-names = "sys", "ss", "tx_a", "rx_a", "tx_b", "rx_b";
        #address-cells = <1>;
        #size-cells = <0>;

        mmc@0 {
          compatible = "mxic,uefc-mmc";
          reg = <0>;
        };
      };
    };
...
```

## Documentation/devicetree/bindings/mtd/mxic,uefc-nand.yaml
```yaml
# SPDX-License-Identifier: (GPL-2.0-only OR BSD-2-Clause)
%YAML 1.2
---
$id: http://devicetree.org/schemas/mtd/mxic,uefc-nand.yaml#
$schema: http://devicetree.org/meta-schemas/core.yaml#

title: Macronix UEFC NAND controller

maintainers:
  - Cheng Ming Lin <linchengming884@gmail.com>

description: |
  The NAND sub-node of the Macronix UEFC drives a raw NAND channel of the host
  controller. See mxic,uefc.yaml for the parent device.

allOf:
  - $ref: nand-controller.yaml

properties:
  compatible:
    enum:
      - mxic,uefc-nand

  dmas:
    description: DMA channel for DMA slave mode

  reg:
    description: UEFC channel used
    enum: [0, 1]

required:
  - compatible
  - reg

unevaluatedProperties: false

examples:
  - |

    amba {
      #address-cells = <1>;
      #size-cells = <1>;

      uefc: uefc@43a00000 {
        compatible = "mxic,uefc";
        reg = <0x43a00000 0x1000>;
        clocks = <&clk_sys>, <&clk_ss>, <&clk_ss>, <&clk_ss>, <&clk_ss>, <&clk_ss>;
        clock-names = "sys", "ss", "tx_a", "rx_a", "tx_b", "rx_b";
        #address-cells = <1>;
        #size-cells = <0>;

        nand-controller@1 {
          compatible = "mxic,uefc-nand";
          #address-cells = <1>;
          #size-cells = <0>;
          reg = <1>;
        };
      };
    };
...
```

## Documentation/devicetree/bindings/spi/mxic,uefc-xspi.yaml
```yaml
# SPDX-License-Identifier: (GPL-2.0-only OR BSD-2-Clause)
%YAML 1.2
---
$id: http://devicetree.org/schemas/spi/mxic,uefc-xspi.yaml#
$schema: http://devicetree.org/meta-schemas/core.yaml#

title: Macronix UEFC xSPI interface

maintainers:
  - Cheng Ming Lin <linchengming884@gmail.com>

description: |
  The xSPI sub-node of the Macronix UEFC drives a SPI/OctaSPI memory channel of
  the host controller. See mxic,uefc.yaml for the parent device.

allOf:
  - $ref: spi-controller.yaml#

properties:
  compatible:
    enum:
      - mxic,uefc-xspi

  dmas:
    description: DMA channel for DMA slave mode

  reg:
    description: UEFC channel used
    enum: [0, 1]

required:
  - compatible
  - reg

unevaluatedProperties: false

examples:
  - |
    amba {
      #address-cells = <1>;
      #size-cells = <1>;

      uefc0: uefc@43a00000 {
        compatible = "mxic,uefc";
        reg = <0x43a00000 0x1000>;
        clocks = <&clk_sys>, <&clk_ss>, <&clk_ss>, <&clk_ss>, <&clk_ss>, <&clk_ss>;
        clock-names = "sys", "ss", "tx_a", "rx_a", "tx_b", "rx_b";
        #address-cells = <1>;
        #size-cells = <0>;

        spi@0 {
          compatible = "mxic,uefc-xspi";
          #address-cells = <1>;
          #size-cells = <0>;
          reg = <0>;

          flash@0 {
            compatible = "jedec,spi-nor";
            reg = <0x0>, <0x1>;
            parallel-memories = /bits/ 64  <0x1000000 0x1000000>; /* 16MB */
          };
        };
      };

      uefc1: uefc@43b00000 {
        compatible = "mxic,uefc";
        reg = <0x43b00000 0x1000>;
        clocks = <&clk_sys>, <&clk_ss>, <&clk_ss>, <&clk_ss>, <&clk_ss>, <&clk_ss>;
        clock-names = "sys", "ss", "tx_a", "rx_a", "tx_b", "rx_b";
        #address-cells = <1>;
        #size-cells = <0>;

        spi@0 {
          compatible = "mxic,uefc-xspi";
          #address-cells = <1>;
          #size-cells = <0>;
          reg = <0>;

          flash@0 {
            compatible = "jedec,spi-nor";
            reg = <0>;
          };
        };

        spi@1 {
          compatible = "mxic,uefc-xspi";
          #address-cells = <1>;
          #size-cells = <0>;
          reg = <0>;

          flash@0 {
            compatible = "jedec,spi-nor";
            reg = <0>;
          };
        };
      };
    };
...
```
